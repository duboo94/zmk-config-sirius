## config/boards/shields/sirius/Kconfig.defconfig
```kconfig
if SHIELD_SIRIUS_DONGLE

config ZMK_KEYBOARD_NAME
    default "SIRIUS SPLIT"

config ZMK_SPLIT_ROLE_CENTRAL
    default y

endif

if SHIELD_SIRIUS_DONGLE || SHIELD_SIRIUS_LEFT || SHIELD_SIRIUS_RIGHT

config ZMK_SPLIT
    default y

endif
```

## config/boards/shields/sirius/Kconfig.shield
```kconfig
config SHIELD_SIRIUS_DONGLE
    def_bool $(shields_list_contains,sirius_dongle)

config SHIELD_SIRIUS_LEFT
    def_bool $(shields_list_contains,sirius_left)

config SHIELD_SIRIUS_RIGHT
    def_bool $(shields_list_contains,sirius_right)
```
